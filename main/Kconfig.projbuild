## main/Kconfig.projbuild
```kconfig
menu "LD2450 Radar"

    config RADAR_UART_NUM
        int "UART port for the radar"
        range 1 2
        default 2

    config RADAR_RX_GPIO
        int "ESP32 RX pin (connect to LD2450 TX)"
        default 16

    config RADAR_TX_GPIO
        int "ESP32 TX pin (connect to LD2450 RX)"
        default 17

    config RADAR_BAUD
        int "Radar baud rate"
        default 256000
        help
            Factory default of the HLK-LD2450 is 256000 baud.

    config RADAR_MAX_RANGE_MM
        int "Range shown as an empty proximity bar (mm)"
        default 6000

endmenu

menu "OLED Display"

    config OLED_ENABLE
        bool "Use an SSD1306 I2C OLED"
        default y

    config OLED_SDA_GPIO
        int "I2C SDA pin"
        depends on OLED_ENABLE
        default 21

    config OLED_SCL_GPIO
        int "I2C SCL pin"
        depends on OLED_ENABLE
        default 22

    config OLED_I2C_ADDR
        hex "I2C address"
        depends on OLED_ENABLE
        default 0x3C
        help
            Most modules use 0x3C, some 0x3D (see the solder jumper on the back).

    choice OLED_HEIGHT_CHOICE
        prompt "Display height"
        depends on OLED_ENABLE
        default OLED_HEIGHT_64
        config OLED_HEIGHT_64
            bool "128x64 (0.96\" / 1.3\" SSD1306)"
        config OLED_HEIGHT_32
            bool "128x32 (0.91\" SSD1306)"
    endchoice

    config OLED_HEIGHT
        int
        default 64 if OLED_HEIGHT_64
        default 32 if OLED_HEIGHT_32
        default 64

    config OLED_ROTATE_180
        bool "Rotate display by 180 degrees"
        depends on OLED_ENABLE
        default n

endmenu
```
